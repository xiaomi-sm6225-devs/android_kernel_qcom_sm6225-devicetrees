#include "trinket-sde-display-iot-idp.dtsi"

&sde_dp {
	status = "okay";
	qcom,dp-hpd-gpio = <&tlmm 100 0>;
	qcom,dp-low-power-hw-hpd;
};

&mdss_mdp {
	/delete-property/ connectors;
	connectors = <&sde_dsi &sde_wb &sde_dp &smmu_sde_sec &smmu_sde_unsec>;
};
